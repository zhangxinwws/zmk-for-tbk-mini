## config/boards/shields/Y64/Kconfig.shield
```kconfig
# Copyright (c) 2020 Ryan Cross
# SPDX-License-Identifier: MIT

config SHIELD_Y64_LEFT
	def_bool $(shields_list_contains,Y64_left)

config SHIELD_Y64_RIGHT
	def_bool $(shields_list_contains,Y64_right)
```
